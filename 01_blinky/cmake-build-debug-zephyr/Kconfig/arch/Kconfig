## 01_blinky/cmake-build-debug-zephyr/Kconfig/arch/Kconfig
```kconfig
# Load Zephyr Arch Kconfig descriptions.
osource "/home/mason/01_project/zephyrproject/zephyr/arch/rx/Kconfig"
osource "/home/mason/01_project/zephyrproject/zephyr/arch/x86/Kconfig"
osource "/home/mason/01_project/zephyrproject/zephyr/arch/xtensa/Kconfig"
osource "/home/mason/01_project/zephyrproject/zephyr/arch/sparc/Kconfig"
osource "/home/mason/01_project/zephyrproject/zephyr/arch/riscv/Kconfig"
osource "/home/mason/01_project/zephyrproject/zephyr/arch/posix/Kconfig"
osource "/home/mason/01_project/zephyrproject/zephyr/arch/openrisc/Kconfig"
osource "/home/mason/01_project/zephyrproject/zephyr/arch/mips/Kconfig"
osource "/home/mason/01_project/zephyrproject/zephyr/arch/arm64/Kconfig"
osource "/home/mason/01_project/zephyrproject/zephyr/arch/arm/Kconfig"
osource "/home/mason/01_project/zephyrproject/zephyr/arch/arc/Kconfig"
```

## 02_input/build/Kconfig/Kconfig.shield.defconfig
```kconfig
osource "/home/mason/01_project/ZephyrOnEsp32/input/boards/shields/*/Kconfig.defconfig"
```

## 02_input/build/Kconfig/boards/Kconfig.defconfig
```kconfig
# Load Zephyr board defconfig descriptions.
osource "/home/mason/01_project/ZephyrOnEsp32/input/boards/xtensa/esp32_s3_board/Kconfig.defconfig"
```

## 03_hello_world/build/Kconfig/Kconfig.shield
```kconfig
osource "/home/mason/01_project/ZephyrOnEsp32/hello_world/boards/shields/*/Kconfig.shield"
```

## 03_hello_world/build/Kconfig/Kconfig.shield.defconfig
```kconfig
osource "/home/mason/01_project/ZephyrOnEsp32/03_hello_world/boards/shields/*/Kconfig.defconfig"
```

## 03_hello_world/build/Kconfig/boards/Kconfig.defconfig
```kconfig
# Load Zephyr board defconfig descriptions.
osource "/home/mason/01_project/zephyrproject/zephyr/boards/espressif/esp32s3_devkitc/Kconfig.defconfig"
```

## 03_hello_world/build/Kconfig/boards/Kconfig.esp32s3_devkitc
```kconfig
# Load board Kconfig descriptions.
osource "/home/mason/01_project/zephyrproject/zephyr/boards/espressif/esp32s3_devkitc/Kconfig.esp32s3_devkitc"
```

## 03_hello_world/build/Kconfig/boards/Kconfig.sysbuild
```kconfig
# Load Sysbuild board Kconfig descriptions.
osource "/home/mason/01_project/zephyrproject/zephyr/boards/espressif/esp32s3_devkitc/Kconfig.sysbuild"
```

## 04_DHT11/build/Kconfig/Kconfig.shield.defconfig
```kconfig
osource "/home/mason/01_project/ZephyrOnEsp32/04_DHT11/boards/shields/*/Kconfig.defconfig"
```

## 04_DHT11/build/Kconfig/boards/Kconfig.defconfig
```kconfig
# Load Zephyr board defconfig descriptions.
osource "/home/mason/01_project/ZephyrOnEsp32/04_DHT11/boards/xtensa/esp32_s3_board/Kconfig.defconfig"
```

## 04_DHT11/build/Kconfig/boards/Kconfig.esp32_s3_board
```kconfig
# Load board Kconfig descriptions.
osource "/home/mason/01_project/ZephyrOnEsp32/04_DHT11/boards/xtensa/esp32_s3_board/Kconfig.esp32_s3_board"
```

## 04_DHT11/build/Kconfig/boards/Kconfig.sysbuild
```kconfig
# Load Sysbuild board Kconfig descriptions.
osource "/home/mason/01_project/ZephyrOnEsp32/04_DHT11/boards/xtensa/esp32_s3_board/Kconfig.sysbuild"
```

## 05_PWM_LED/boards/xtensa/esp32_s3_board/Kconfig.esp32_s3_board
```kconfig
config BOARD_ESP32_S3_BOARD
    bool "ESPRESSIF ESP32-S3 BOARD"
    select SOC_ESP32S3
    help
        My Board is simple esp32, very cheap
```

## 05_PWM_LED/build/Kconfig/Kconfig.shield.defconfig
```kconfig
osource "/home/mason/01_project/ZephyrOnEsp32/05_PWM_LED/boards/shields/*/Kconfig.defconfig"
```

## 05_PWM_LED/build/Kconfig/boards/Kconfig
```kconfig
# Load Zephyr board Kconfig descriptions.
osource "/home/mason/01_project/ZephyrOnEsp32/05_PWM_LED/boards/xtensa/esp32_s3_board/Kconfig"
```

## 05_PWM_LED/build/Kconfig/boards/Kconfig.defconfig
```kconfig
# Load Zephyr board defconfig descriptions.
osource "/home/mason/01_project/ZephyrOnEsp32/05_PWM_LED/boards/xtensa/esp32_s3_board/Kconfig.defconfig"
```

## 05_PWM_LED/cmake-build-debug-zephyr/Kconfig/Kconfig.shield.defconfig
```kconfig
osource "/home/mason/01_project/zephyrproject/HelloLED/blinky/boards/shields/*/Kconfig.defconfig"
```

## 05_PWM_LED/cmake-build-debug-zephyr/Kconfig/boards/Kconfig.defconfig
```kconfig
# Load Zephyr board defconfig descriptions.
osource "/home/mason/01_project/zephyrproject/HelloLED/blinky/boards/xtensa/esp32_s3_board/Kconfig.defconfig"
```

## 06_TFT_Screen/boards/xtensa/esp32_s3_board/Kconfig
```kconfig
config HEAP_MEM_POOL_ADD_SIZE_BOARD
	int
	default 4096 if BOARD_ESP32_S3_BOARD_ESP32S3_PROCPU
	default 256 if BOARD_ESP32_S3_BOARD_ESP32S3_APPCPU
```

## 06_TFT_Screen/build/Kconfig/Kconfig.shield
```kconfig
osource "/home/mason/01_project/ZephyrOnEsp32/06_TFT_Screen/boards/shields/*/Kconfig.shield"
```

## 06_TFT_Screen/build/Kconfig/boards/Kconfig.defconfig
```kconfig
# Load Zephyr board defconfig descriptions.
osource "/home/mason/01_project/ZephyrOnEsp32/06_TFT_Screen/boards/xtensa/esp32_s3_board/Kconfig.defconfig"
```

## 06_TFT_Screen/build/Kconfig/boards/Kconfig.esp32_s3_board
```kconfig
# Load board Kconfig descriptions.
osource "/home/mason/01_project/ZephyrOnEsp32/06_TFT_Screen/boards/xtensa/esp32_s3_board/Kconfig.esp32_s3_board"
```

## blinky/boards/xtensa/esp32_s3_board/board.yml
```yaml
board:
  name: esp32_s3_board
  full_name: ESPRESSIF ESP32-S3 BOARD
  vendor: Espressif
  socs:
    - name: esp32s3
```

## blinky/cmake-build-debug-zephyr/Kconfig/boards/Kconfig
```kconfig
# Load Zephyr board Kconfig descriptions.
osource "/home/mason/01_project/zephyrproject/HelloLED/blinky/boards/xtensa/esp32_s3_board/Kconfig"
```
